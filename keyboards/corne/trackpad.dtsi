/*
 * Cirque trackpad on the right (peripheral) half, relayed to the central.
 * The listener is disabled here so the keymap can reference it on both halves.
 */

/ {
    split_inputs {
        #address-cells = <1>;
        #size-cells = <0>;

        trackpad_split: trackpad_split@0 {
            compatible = "zmk,input-split";
            reg = <0>;
        };
    };

    trackpad_listener: trackpad_listener {
        compatible = "zmk,input-listener";
        status = "disabled";
        device = <&trackpad_split>;
    };
};
